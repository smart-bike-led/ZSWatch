## prj.conf
```kconfig
CONFIG_LV_Z_MEM_POOL_NUMBER_BLOCKS=8
CONFIG_MAIN_STACK_SIZE=1024
CONFIG_SYSTEM_WORKQUEUE_STACK_SIZE=3000
CONFIG_HEAP_MEM_POOL_SIZE=25000
CONFIG_NEWLIB_LIBC_FLOAT_PRINTF=y
CONFIG_CBPRINTF_FP_SUPPORT=y

CONFIG_ASSERT=y
CONFIG_REBOOT=y
CONFIG_DISPLAY=y

CONFIG_I2C=y
CONFIG_SENSOR=y
CONFIG_ADC=y
CONFIG_BMI270=n
CONFIG_LIS2MDL=y
CONFIG_BME680=y


CONFIG_MAX30101=y
CONFIG_MAX30101_MULTI_LED_MODE=y
CONFIG_MAX30101_SLOT1=1
CONFIG_MAX30101_SLOT2=2
CONFIG_MAX30101_SLOT3=3
CONFIG_MAX30101_SLOT4=0

CONFIG_PINCTRL=y
CONFIG_PM_DEVICE=y
CONFIG_PM_DEVICE_RUNTIME=y

CONFIG_PWM=y

CONFIG_SPI=y
CONFIG_GC9A01=y
CONFIG_KSCAN_CST816S=n
CONFIG_KSCAN_MODIFIED_CST816S=y
CONFIG_KSCAN_CST816S_INTERRUPT=y
CONFIG_KSCAN=y
CONFIG_LV_Z_POINTER_KSCAN=y
CONFIG_LV_Z_POINTER_KSCAN_SWAP_XY=y
CONFIG_LV_Z_POINTER_KSCAN_INVERT_X=y
CONFIG_REGULATOR=y
CONFIG_REGULATOR_FIXED=y

CONFIG_LVGL=y
CONFIG_LV_MEM_CUSTOM=y
CONFIG_LV_FONT_MONTSERRAT_14=y
CONFIG_LV_FONT_MONTSERRAT_18=y
CONFIG_LV_FONT_MONTSERRAT_24=y
CONFIG_LV_FONT_MONTSERRAT_28=y



# Comment out to show FPS counter
#CONFIG_LV_USE_PERF_MONITOR=y
#CONFIG_LV_PERF_MONITOR_ALIGN_RIGHT_MID=y

CONFIG_LV_Z_DOUBLE_VDB=n
CONFIG_LV_Z_VDB_SIZE=25
CONFIG_LV_DISP_DEF_REFR_PERIOD=30
CONFIG_LV_INDEV_DEF_READ_PERIOD=30

CONFIG_LV_THEME_DEFAULT_DARK=y

# LVGL Size optimizations
CONFIG_LV_LABEL_TEXT_SELECTION=n
CONFIG_LV_LABEL_LONG_TXT_HINT=n
CONFIG_LV_USE_LOG=n
CONFIG_LV_USE_BAR=y
CONFIG_LV_USE_CANVAS=n
CONFIG_LV_USE_CHECKBOX=n
CONFIG_LV_USE_DROPDOWN=n
CONFIG_LV_USE_LINE=y
CONFIG_LV_USE_ROLLER=n
CONFIG_LV_USE_SLIDER=y
CONFIG_LV_USE_SWITCH=y
CONFIG_LV_USE_TABLE=n
CONFIG_LV_USE_TEXTAREA=n
CONFIG_LV_USE_FLEX=y
CONFIG_LV_USE_ANIMIMG=y
CONFIG_LV_USE_CALENDAR=n
CONFIG_LV_USE_CHART=y
CONFIG_LV_USE_COLORWHEEL=n
CONFIG_LV_USE_IMGBTN=y
CONFIG_LV_USE_KEYBOARD=n
CONFIG_LV_USE_LED=n
CONFIG_LV_USE_LIST=y
CONFIG_LV_USE_MENU=y
CONFIG_LV_USE_METER=y
CONFIG_LV_USE_MSGBOX=y
CONFIG_LV_USE_SPINBOX=n
CONFIG_LV_USE_SPINNER=n
CONFIG_LV_USE_TABVIEW=n
CONFIG_LV_USE_TILEVIEW=n
CONFIG_LV_USE_WIN=n
CONFIG_LV_USE_SPAN=n
CONFIG_LV_USE_USER_DATA=y

CONFIG_LV_COLOR_16_SWAP=y
CONFIG_LV_COLOR_DEPTH_16=y

#
# Memory settings
#
# CONFIG_LV_MEM_CUSTOM is not set
CONFIG_LV_MEM_SIZE_KILOBYTES=25
CONFIG_LV_MEM_ADDR=0x0
CONFIG_LV_MEM_BUF_MAX_NUM=16
# end of Memory settings

# NVS
CONFIG_FLASH=y
CONFIG_FLASH_MAP=y
CONFIG_MPU_ALLOW_FLASH_WRITE=y
CONFIG_FLASH_PAGE_LAYOUT=y

# Filesystem
CONFIG_FILE_SYSTEM=y
CONFIG_FILE_SYSTEM_LITTLEFS=y

CONFIG_SETTINGS=y
CONFIG_NVS=y

# Bluetooth
CONFIG_BT=y
CONFIG_BT_HCI=y
CONFIG_BT_CTLR=n
# Enable Direction Finding TX Feature including AoA and AoD
CONFIG_BT_DF=y
CONFIG_BT_DF_CONNECTIONLESS_CTE_TX=y
#CONFIG_BT_RX_STACK_SIZE=2048
# Enable chaining of multiple CTEs in periodic advertising
CONFIG_BT_DEBUG_LOG=n
CONFIG_BT_SMP=y
CONFIG_BT_PERIPHERAL=y
CONFIG_BT_DIS=y
CONFIG_BT_DIS_PNP=n
CONFIG_BT_BAS=n
CONFIG_BT_HRS=n
CONFIG_BT_DEVICE_NAME="ZSWatch"
CONFIG_BT_DEVICE_APPEARANCE=194
CONFIG_BT_KEYS_OVERWRITE_OLDEST=y
CONFIG_BT_SETTINGS=y
CONFIG_BT_MAX_PAIRED=5
CONFIG_BT_MAX_CONN=1

CONFIG_BT_GATT_CLIENT=y

CONFIG_BT_EXT_ADV=y
CONFIG_BT_PER_ADV=y

CONFIG_BT_BROADCASTER=y
CONFIG_BT_SMP_ALLOW_UNAUTH_OVERWRITE=y
CONFIG_BT_ECC=y
#CONFIG_BT_CONN_PARAM_UPDATE_TIMEOUT=
CONFIG_BT_EXT_ADV_MAX_ADV_SET=2
CONFIG_BT_BUF_ACL_RX_SIZE=100
CONFIG_BT_BUF_ACL_TX_SIZE=100
CONFIG_BT_L2CAP_TX_MTU=96

# Allows to do some basic UI tasks in BT callbacks.
CONFIG_BT_RX_STACK_SIZE=3000

CONFIG_NEWLIB_LIBC=y
CONFIG_POSIX_API=y

CONFIG_PM=y

# Size optimizations
#CONFIG_SIZE_OPTIMIZATIONS=y
# CONFIG_THREAD_STACK_INFO=n

# By default disable UART to save power
CONFIG_SERIAL=n
CONFIG_CONSOLE=n
CONFIG_UART_CONSOLE=n

CONFIG_ZBUS=y
CONFIG_ZBUS_RUNTIME_OBSERVERS_POOL_SIZE=5
CONFIG_ZBUS_CHANNEL_NAME=y
CONFIG_ZBUS_OBSERVER_NAME=y
CONFIG_DISPLAY_FAST_WAKEUP=y
# Disable this to exclude flash intensive apps mean for demo only
CONFIG_DEMO_BUILD=n
```

## boards/debug.conf
```kconfig
CONFIG_DISABLE_PAIRING_REQUIRED=y
CONFIG_SENSOR_LOG_LEVEL_DBG=y
CONFIG_THREAD_NAME=y
CONFIG_PRINTK=y

# SEGGER RTT logging instead of UART
CONFIG_LOG_PRINTK=y
CONFIG_LOG=y
CONFIG_DEBUG_OPTIMIZATIONS=y
CONFIG_USE_SEGGER_RTT=y
CONFIG_LOG_BACKEND_RTT=y
#CONFIG_LOG_BACKEND_RTT_MODE_OVERWRITE=y
# End of SEGGER RTT

#CONFIG_RESET_ON_FATAL_ERROR=y
```

## boards/release.conf
```kconfig
# SEGGER RTT logging instead of UART
CONFIG_LOG_PRINTK=n
CONFIG_LOG=n
CONFIG_DEBUG_OPTIMIZATIONS=n
CONFIG_USE_SEGGER_RTT=n
CONFIG_RTT_CONSOLE=n
CONFIG_UART_CONSOLE=n
CONFIG_LOG_BACKEND_RTT=n
CONFIG_LOG_BACKEND_UART=n
# End of SEGGER RTT

CONFIG_SPEED_OPTIMIZATIONS=y

#CONFIG_RESET_ON_FATAL_ERROR=y

CONFIG_WATCHDOG=y
CONFIG_WDT_DISABLE_AT_BOOT=y
CONFIG_TASK_WDT=y
CONFIG_TASK_WDT_MIN_TIMEOUT=1000
CONFIG_TASK_WDT_HW_FALLBACK=y
```

## src/main.c
```c
#include <zephyr/device.h>
#include <zephyr/drivers/display.h>
#include <zephyr/sys/reboot.h>
#include <stdio.h>
#include <string.h>
#include <zephyr/kernel.h>
#include <buttons.h>
#include <battery.h>
#include <gpio_debug.h>
#include <zephyr/drivers/sensor.h>
#include <zephyr/drivers/pwm.h>
#include <zephyr/bluetooth/bluetooth.h>
#include <zephyr/settings/settings.h>
#include <zephyr/drivers/led.h>
#include <zephyr/logging/log.h>
#include <clock.h>
#include <lvgl.h>
#include "watchface_app.h"
#include <heart_rate_sensor.h>
#include <sys/time.h>
#include <ram_retention_storage.h>
#include <accelerometer.h>
#include <ble_comm.h>
#include <ble_aoa.h>
#include <lv_notifcation.h>
#include <notification_manager.h>
#include <notifications_page.h>
#include <vibration_motor.h>
#include <display_control.h>
#include <applications/application_manager.h>
#include <events/ble_data_event.h>
#include <events/accel_event.h>
#include <magnetometer.h>
#include <pressure_sensor.h>
#include <zephyr/zbus/zbus.h>
#include <zsw_cpu_freq.h>
#include <zsw_charger.h>
#include <zsw_power_manager.h>
#include <zephyr/bluetooth/bluetooth.h>
#include <zephyr/bluetooth/hci.h>
#include <zephyr/task_wdt/task_wdt.h>

LOG_MODULE_REGISTER(main, LOG_LEVEL_WRN);

#define TASK_WDT_FEED_INTERVAL_MS  3000

typedef enum ui_state {
    INIT_STATE,
    SETTINGS_STATE,
    WATCHFACE_STATE,
    APPLICATION_MANAGER_STATE,
    NOTIFCATION_STATE,
    NOTIFCATION_LIST_STATE,
} ui_state_t;

static void run_init_work(struct k_work *item);

static void run_wdt_work(struct k_work *item);
static void enable_bluetoth(void);
static void open_notifications_page(void *unused);
static bool load_retention_ram(void);
static void enocoder_read(struct _lv_indev_drv_t *indev_drv, lv_indev_data_t *data);
static void click_feedback(struct _lv_indev_drv_t *drv, uint8_t e);
static void play_not_vibration(void);
static void ble_data_cb(ble_comm_cb_data_t *cb);
static void open_notification_popup(void *data);
static void async_turn_off_buttons_allocation(void *unused);
static void on_popup_notifcation_closed(uint32_t id);
static void on_notification_page_close(void);
static void on_notification_page_notification_close(uint32_t not_id);
static void zbus_ble_comm_data_callback(const struct zbus_channel *chan);

static void onButtonPressCb(buttonPressType_t type, buttonId_t id);
static void screen_gesture_event(lv_event_t *e);

static void on_close_application_manager(void);

K_WORK_DELAYABLE_DEFINE(wdt_work, run_wdt_work);
static int kernal_wdt_id;

static bool buttons_allocated = false;
static lv_group_t *input_group;
static lv_indev_drv_t enc_drv;
static lv_indev_t *enc_indev;
static buttonId_t last_pressed;

static bool vibrator_on = false;

static ui_state_t watch_state = INIT_STATE;

K_WORK_DEFINE(init_work, run_init_work);

ZBUS_CHAN_DECLARE(ble_comm_data_chan);
ZBUS_LISTENER_DEFINE(main_ble_comm_lis, zbus_ble_comm_data_callback);

static void run_init_work(struct k_work *item)
{
    lv_indev_t *touch_indev;

    zsw_cpu_set_freq(ZSW_CPU_FREQ_FAST, true);
    load_retention_ram();
    heart_rate_sensor_init();
    notifications_page_init(on_notification_page_close, on_notification_page_notification_close);
    notification_manager_init();
    enable_bluetoth();
    accelerometer_init();
    magnetometer_init();
    pressure_sensor_init();
    clock_init(retained.current_time_seconds);
    buttonsInit(&onButtonPressCb);
    vibration_motor_init();
    vibration_motor_set_on(false);
    // Not to self, PWM consumes like 250uA...
    // Need to disable also when screen is off.
    display_control_init();
    display_control_power_on(true);

    lv_indev_drv_init(&enc_drv);
    enc_drv.type = LV_INDEV_TYPE_ENCODER;
    enc_drv.read_cb = enocoder_read;
    enc_drv.feedback_cb = click_feedback;
    enc_indev = lv_indev_drv_register(&enc_drv);

    input_group = lv_group_create();
    lv_group_set_default(input_group);
    lv_indev_set_group(enc_indev, input_group);

    touch_indev = lv_indev_get_next(NULL);
    while (touch_indev) {
        if (lv_indev_get_type(touch_indev) == LV_INDEV_TYPE_POINTER) {
            // TODO First fix so not all presses everywhere are registered as clicks and cause vibration
            // Clicking anywehere with this below added right now will cause a vibration, which
            // is not what we want
            // touch_indev->driver->feedback_cb = click_feedback;
            break;
        }
        touch_indev = lv_indev_get_next(touch_indev);
    }

    watch_state = WATCHFACE_STATE;
    lv_obj_add_event_cb(lv_scr_act(), screen_gesture_event, LV_EVENT_GESTURE, NULL);
    watchface_app_start(input_group);
}

void run_wdt_work(struct k_work *item)
{
    task_wdt_feed(kernal_wdt_id);
    k_work_schedule(&wdt_work, K_MSEC(TASK_WDT_FEED_INTERVAL_MS));
}

int main(void)
{
#ifdef CONFIG_TASK_WDT
    const struct device *hw_wdt_dev = DEVICE_DT_GET(DT_ALIAS(watchdog0));
    if (!device_is_ready(hw_wdt_dev)) {
		printk("Hardware watchdog %s is not ready; ignoring it.\n",
		       hw_wdt_dev->name);
		hw_wdt_dev = NULL;
	}

	task_wdt_init(hw_wdt_dev);
    kernal_wdt_id = task_wdt_add(TASK_WDT_FEED_INTERVAL_MS * 2, NULL, NULL);

    k_work_schedule(&wdt_work, K_NO_WAIT);
#endif
    // The init code requires a bit of stack.
    // So in order to not increase CONFIG_MAIN_STACK_SIZE and loose
    // this RAM forever, instead re-use the system workqueue for init
    // it has the required amount of stack.
    k_work_submit(&init_work);
}

static void enable_bluetoth(void)
{
    int err;

#ifdef CONFIG_BOARD_NATIVE_POSIX
    bt_addr_le_t addr;

    err = bt_addr_le_from_str("DE:AD:BE:EF:BA:11", "random", &addr);
    if (err) {
        LOG_ERR("Invalid BT address (err %d)", err);
    }

    err = bt_id_create(&addr, NULL);
    if (err < 0) {
        LOG_ERR("Creating new ID failed (err %d)", err);
    }
#endif

    err = bt_enable(NULL);
    if (err != 0) {
        LOG_ERR("Failed to enable Bluetooth, err: %d", err);
        return;
    }

#ifdef CONFIG_SETTINGS
    settings_load();
#endif

    __ASSERT_NO_MSG(ble_comm_init(ble_data_cb) == 0);
    bleAoaInit();
}

static bool load_retention_ram(void)
{
    bool retained_ok = retained_validate();
    //memset(&retained, 0, sizeof(retained));
    /* Increment for this boot attempt and update. */
    retained.boots += 1;
    retained_update();

    printk("Retained data: %s\n", retained_ok ? "valid" : "INVALID");
    printk("Boot count: %u\n", retained.boots);
    printk("uptime_latest: %" PRIu64 "\n", retained.uptime_latest);
    printk("Active Ticks: %" PRIu64 "\n", retained.uptime_sum);

    return retained_ok;
}

static void open_notification_popup(void *data)
{
    not_mngr_notification_t *not = notification_manager_get_newest();
    if (not != NULL) {
        play_not_vibration();
        lv_notification_show(not->title, not->body, not->src, not->id, on_popup_notifcation_closed, 10);
        buttons_allocated = true;
    } else {
        buttons_allocated = false;
    }
}

static void open_notifications_page(void *unused)
{
    not_mngr_notification_t notifications[NOTIFICATION_MANAGER_MAX_STORED];
    int num_unread = 0;
    watchface_app_stop();
    buttons_allocated = true;
    watch_state = NOTIFCATION_LIST_STATE;
    notification_manager_get_all(notifications, &num_unread);
    notifications_page_create(notifications, num_unread, input_group);
}

static void open_application_manager_page(void *unused)
{
    watchface_app_stop();
    buttons_allocated = true;
    watch_state = APPLICATION_MANAGER_STATE;
    application_manager_show(on_close_application_manager, lv_scr_act(), input_group, NULL);
}

static void play_press_vibration(void)
{
    vibrator_on = true;
    vibration_motor_set_on(true);
    vibration_motor_set_power(75);
    k_msleep(100);
    vibration_motor_set_power(75);
    vibration_motor_set_on(false);
    vibration_motor_set_power(0);
    vibrator_on = false;
}

static void play_not_vibration(void)
{
    vibrator_on = true;
    vibration_motor_set_power(100);
    vibration_motor_set_on(true);
    k_msleep(50);
    vibration_motor_set_on(false);
    k_msleep(50);
    vibration_motor_set_on(true);
    k_msleep(50);
    vibration_motor_set_on(false);
    k_msleep(50);
    vibration_motor_set_power(0);
    vibration_motor_set_on(true);
    k_msleep(50);
    vibration_motor_set_on(false);
    vibrator_on = false;
}

static void on_popup_notifcation_closed(uint32_t id)
{
    // Notification was dismissed, hence consider it read.
    // TODO send to phone that the notification was read.
    notification_manager_remove(id);
    lv_async_call(async_turn_off_buttons_allocation, NULL);
}

static void on_notification_page_close(void)
{
    lv_async_call(async_turn_off_buttons_allocation, NULL);
    watch_state = WATCHFACE_STATE;
    watchface_app_start(input_group);
}

static void on_notification_page_notification_close(uint32_t not_id)
{
    // TODO send to phone that the notification was read.
    notification_manager_remove(not_id);
}

static void on_close_application_manager(void)
{
    application_manager_delete();
    watch_state = WATCHFACE_STATE;
    watchface_app_start(input_group);
    lv_async_call(async_turn_off_buttons_allocation, NULL);
}

static void async_turn_off_buttons_allocation(void *unused)
{
    buttons_allocated = false;
}

static void onButtonPressCb(buttonPressType_t type, buttonId_t id)
{
    LOG_WRN("Pressed %d, type: %d", id, type);

    if (zsw_power_manager_reset_idle_timout()) {
        // Don't process the press if it caused wakeup.
        return;
    }

    // Always allow force restart
    if (type == BUTTONS_LONG_PRESS && id == BUTTON_TOP_LEFT) {
        retained.off_count += 1;
        retained_update();
        sys_reboot(SYS_REBOOT_COLD);
    }

    if (id == BUTTON_BOTTOM_RIGHT && watch_state == APPLICATION_MANAGER_STATE) {
        application_manager_exit_app();
        return;
    }

    if (buttons_allocated) {
        // Handled by LVGL
        return;
    }

    // A bit hacky, but if we consumed the fake press in the callback
    // we need to clear it, otherwise LVGL will think the button is still pressed later.
    // Clear it by reading the button.
    button_read(id);

    if (type == BUTTONS_SHORT_PRESS && watch_state == WATCHFACE_STATE) {
        play_press_vibration();
        if (id == BUTTON_TOP_LEFT) {
            LOG_DBG("Close Watchface, open App Manager");
            lv_async_call(open_application_manager_page, NULL);
        } else if (id == BUTTON_BOTTOM_RIGHT) {
            LOG_DBG("CloseWatchface, open Notifications page");
            lv_async_call(open_notifications_page, NULL);
        } else {
            LOG_WRN("Unhandled button %d, type: %d, watch_state: %d", id, type, watch_state);
        }
    } else {
        if (id == BUTTON_TOP_LEFT) {
            retained.off_count += 1;
            retained_update();
            sys_reboot(SYS_REBOOT_COLD);
        } else {
            LOG_WRN("Unhandled button %d, type: %d, watch_state: %d", id, type, watch_state);
        }
    }
}

static void enocoder_read(struct _lv_indev_drv_t *indev_drv, lv_indev_data_t *data)
{
    if (!buttons_allocated) {
        return;
    }
    if (button_read(BUTTON_TOP_LEFT)) {
        data->key = LV_KEY_LEFT;
        data->state = LV_INDEV_STATE_PR;
        last_pressed = BUTTON_TOP_LEFT;
    } else if (button_read(BUTTON_TOP_RIGHT)) {
        data->key = LV_KEY_ENTER;
        data->state = LV_INDEV_STATE_PR;
        last_pressed = BUTTON_TOP_RIGHT;
    } else if (button_read(BUTTON_BOTTOM_LEFT)) {
        data->key = LV_KEY_RIGHT;
        data->state = LV_INDEV_STATE_PR;
        last_pressed = BUTTON_BOTTOM_LEFT;
    } else if (button_read(BUTTON_BOTTOM_RIGHT)) {
        // Not used for now. TODO exit/back button.
    } else {
        if (last_pressed == 0xFF) {
            return;
        }
        data->state = LV_INDEV_STATE_REL;
        switch (last_pressed) {
            case BUTTON_TOP_LEFT:
                data->key = LV_KEY_RIGHT;
                break;
            case BUTTON_TOP_RIGHT:
                data->key = LV_KEY_ENTER;
                break;
            case BUTTON_BOTTOM_LEFT:
                data->key = LV_KEY_LEFT;
                break;
            default:
                break;
        }
        last_pressed = 0xFF;
    }
}

static void screen_gesture_event(lv_event_t *e)
{
    lv_event_code_t event = lv_event_get_code(e);
    if (event == LV_EVENT_GESTURE) {
        lv_dir_t  dir = lv_indev_get_gesture_dir(lv_indev_get_act());
#ifdef __ZEPHYR__
        LOG_WRN("EVENT_GESTURE dir: %d\n", dir);
#endif
        if (watch_state == WATCHFACE_STATE) {
            watchface_app_stop();
            buttons_allocated = true;
            watch_state = APPLICATION_MANAGER_STATE;

            switch (dir) {
                case LV_DIR_BOTTOM:
                    application_manager_show(on_close_application_manager, lv_scr_act(), input_group, NULL);
                    break;
                case LV_DIR_TOP:
                    application_manager_show(on_close_application_manager, lv_scr_act(), input_group, "Music");
                    break;
                case LV_DIR_RIGHT:
                    application_manager_show(on_close_application_manager, lv_scr_act(), input_group, "QR Code");
                    break;
                case LV_DIR_LEFT:
                    application_manager_show(on_close_application_manager, lv_scr_act(), input_group, "Sensors");
                    break;
                default:
                    break;
            }
        } else if (watch_state == APPLICATION_MANAGER_STATE && dir == LV_DIR_RIGHT) {
#ifdef CONFIG_BOARD_NATIVE_POSIX
            // Until there is a better way to go back without access to buttons.
            application_manager_exit_app();
#endif
        }
    }
}

void click_feedback(struct _lv_indev_drv_t *drv, uint8_t e)
{
    if (e == LV_EVENT_CLICKED) {
        if (!vibrator_on) {
            play_press_vibration();
        }
    }
}

static void ble_data_cb(ble_comm_cb_data_t *cb)
{
    not_mngr_notification_t *parsed_not;

    switch (cb->type) {
        case BLE_COMM_DATA_TYPE_NOTIFY:
            parsed_not = notification_manager_add(&cb->data.notify);
            if (!parsed_not) {
                return;
            }
            if (buttons_allocated) {
                return;
            }
            zsw_power_manager_reset_idle_timout();

            buttons_allocated = true;
            lv_async_call(open_notification_popup, NULL);
            break;

        default:
            break;
    }
}

static void zbus_ble_comm_data_callback(const struct zbus_channel *chan)
{
    const struct ble_data_event *event = zbus_chan_const_msg(chan);
    switch (event->data.type) {
        case BLE_COMM_DATA_TYPE_NOTIFY:
            // TODO, this one not supported yet through events
            // Handled in ble_comm callback for now
            break;
        case BLE_COMM_DATA_TYPE_NOTIFY_REMOVE:
            if (notification_manager_remove(event->data.data.notify_remove.id) != 0) {
                LOG_WRN("Notification %d not found", event->data.data.notify_remove.id);
            }
            break;
        case BLE_COMM_DATA_TYPE_SET_TIME: {
            struct timespec tspec;
            tspec.tv_sec = event->data.data.time.seconds;
            tspec.tv_nsec = 0;
            clock_settime(CLOCK_REALTIME, &tspec);
            break;
        }
        case BLE_COMM_DATA_TYPE_WEATHER:
            break;
        case BLE_COMM_DATA_TYPE_REMOTE_CONTROL:
            if (event->data.data.remote_control.button == BUTTON_END) {
                zsw_power_manager_reset_idle_timout();
                if (watch_state == APPLICATION_MANAGER_STATE) {
                    application_manager_delete();
                    application_manager_set_index(0);
                    buttons_allocated = false;
                    watch_state = WATCHFACE_STATE;
                    watchface_app_start(input_group);
                } else if (watch_state == NOTIFCATION_STATE) {
                    notifications_page_close();
                    buttons_allocated = false;
                    watch_state = WATCHFACE_STATE;
                    watchface_app_start(input_group);
                }
            } else {
                button_set_fake_press((buttonId_t)event->data.data.remote_control.button, true);
            }

            break;
        default:
            break;
    }
}
```

## src/display_control.c
```c
#include <display_control.h>
#include <zephyr/kernel.h>
#include <zephyr/device.h>
#include <zephyr/pm/device.h>
#include <zephyr/drivers/pwm.h>
#include <zephyr/drivers/gpio.h>
#include <zephyr/drivers/regulator.h>
#include <zephyr/drivers/display.h>
#include <zephyr/logging/log.h>
#include "lvgl.h"

LOG_MODULE_REGISTER(display_control, LOG_LEVEL_WRN);

static void lvgl_render(struct k_work *item);

static const struct pwm_dt_spec display_blk = PWM_DT_SPEC_GET_OR(DT_ALIAS(display_blk), {});
static const struct device *const reg_dev = DEVICE_DT_GET_OR_NULL(DT_PATH(regulator_3v3_ctrl));
static const struct device *display_dev = DEVICE_DT_GET(DT_CHOSEN(zephyr_display));
static const struct device *touch_dev = DEVICE_DT_GET(DT_CHOSEN(zephyr_keyboard_scan));

K_WORK_DELAYABLE_DEFINE(lvgl_work, lvgl_render);

static struct k_work_sync canel_work_sync;
static bool is_on;
static uint8_t last_brightness = 30;

void display_control_init(void)
{
    if (!device_is_ready(display_dev)) {
        LOG_ERR("Device display not ready.");
    }
    if (!device_is_ready(display_blk.dev)) {
        LOG_WRN("Display brightness control not supported");
    }
    if (!device_is_ready(reg_dev)) {
        LOG_WRN("Display regulator control not supported");
    }
    if (!device_is_ready(touch_dev)) {
        LOG_WRN("Device touch not ready.");
    }
}

void display_control_power_on(bool on)
{
    if (on == is_on) {
        return;
    }
    is_on = on;
    if (on) {
        // Turn on 3V3 regulator that powers display related stuff.
#ifndef CONFIG_DISPLAY_FAST_WAKEUP
        if (device_is_ready(reg_dev)) {
            regulator_enable(reg_dev);
            pm_device_action_run(display_dev, PM_DEVICE_ACTION_TURN_ON);
        }
#endif
        // Resume the display and touch chip
        pm_device_action_run(display_dev, PM_DEVICE_ACTION_RESUME);
        pm_device_action_run(touch_dev, PM_DEVICE_ACTION_RESUME);
        // Turn backlight on.
        display_control_set_brightness(last_brightness);
        display_blanking_off(display_dev);
        k_work_schedule(&lvgl_work, K_MSEC(250));
    } else {
        display_blanking_on(display_dev);
        // Suspend the display and touch chip
        pm_device_action_run(display_dev, PM_DEVICE_ACTION_SUSPEND);
        pm_device_action_run(touch_dev, PM_DEVICE_ACTION_SUSPEND);

        // Turn off 3v3 regulator
#ifndef CONFIG_DISPLAY_FAST_WAKEUP
        if (device_is_ready(reg_dev)) {
            regulator_disable(reg_dev);
            pm_device_action_run(display_dev, PM_DEVICE_ACTION_TURN_OFF);
        }
#endif
        // Turn off PWM peripheral as it consumes like 200-250uA
        display_control_set_brightness(0);
        // Cancel pending call to lv_task_handler
        // Don't waste resosuces to rendering when display is off anyway.
        k_work_cancel_delayable_sync(&lvgl_work, &canel_work_sync);
        // Prepare for next call to lv_task_handler when screen is enabled again,
        // Since the display will have been powered off, we need to tell LVGL
        // to rerender the complete display.
        lv_obj_invalidate(lv_scr_act());
    }
}

uint8_t display_control_get_brightness(void)
{
    return last_brightness;
}

void display_control_set_brightness(uint8_t percent)
{
    if (!device_is_ready(display_blk.dev)) {
        return;
    }
    __ASSERT(percent >= 0 && percent <= 100, "Invalid range for brightness, valid range 0-100, was %d", percent);
    int ret;

    // TODO this is not correct, the FAN5622SX LED driver have 32 different brightness levels
    // and we need to take that into consideration when choosing pwm period and pulse width.
    uint32_t pulse_width = percent * (display_blk.period / 100);

    if (!is_on && percent != 0) {
        LOG_WRN("Setting brightness when display is off may cause issues with active/inactive state, make sure you know what you are doing.");
    }

    if (percent != 0) {
        last_brightness = percent;
    }
    ret = pwm_set_pulse_dt(&display_blk, pulse_width);
    __ASSERT(ret == 0, "pwm error: %d for pulse: %d", ret, pulse_width);
}

static void lvgl_render(struct k_work *item)
{
    //printk("lvgl_render\n");
    const int64_t next_update_in_ms = lv_task_handler();
    //printk("lvgl_render done\n");
    k_work_schedule(&lvgl_work, K_MSEC(next_update_in_ms));
}
```

## src/magnetometer.c
```c
#include <magnetometer.h>
#include <zephyr/kernel.h>
#include <zephyr/device.h>
#include <zephyr/drivers/sensor.h>
#include <zephyr/pm/pm.h>
#include <zephyr/pm/device.h>
#include <zephyr/pm/policy.h>
#include <zephyr/logging/log.h>
#include <inttypes.h>
#include <math.h>

LOG_MODULE_REGISTER(magnetometer, LOG_LEVEL_WRN);

#ifndef M_PI
#define M_PI        3.14159265358979323846
#endif

static const struct device *const magnetometer = DEVICE_DT_GET_OR_NULL(DT_NODELABEL(lis2mdl));

static double xyz_to_rotation(double x, double y, double z);
static void lis2mdl_trigger_handler(const struct device *dev, const struct sensor_trigger *trig);

static double last_heading = 0;

void magnetometer_init(void)
{
    if (!device_is_ready(magnetometer)) {
        LOG_ERR("Device magnetometer is not ready\n");
        return;
    }

    struct sensor_trigger trig;
    struct sensor_value odr_attr;

    odr_attr.val1 = 10; // TODO what value
    odr_attr.val2 = 0;

    if (sensor_attr_set(magnetometer, SENSOR_CHAN_ALL,
                        SENSOR_ATTR_SAMPLING_FREQUENCY, &odr_attr) < 0) {
        LOG_ERR("Cannot set sampling frequency for LIS2MDL\n");
        return;
    }

    trig.type = SENSOR_TRIG_DATA_READY;
    trig.chan = SENSOR_CHAN_MAGN_XYZ;
    sensor_trigger_set(magnetometer, &trig, lis2mdl_trigger_handler);

    // TODO handle power save, enable/disable etc. to save power
    int rc = pm_device_action_run(magnetometer, PM_DEVICE_ACTION_SUSPEND);
    __ASSERT(rc == 0, "Failed to suspend LIS2MDL: %d\n", rc);
}

void magnetometer_set_enable(bool enabled)
{
    if (!device_is_ready(magnetometer)) {
        return;
    }
    int rc;
    if (enabled) {
        rc = pm_device_action_run(magnetometer, PM_DEVICE_ACTION_RESUME);
        __ASSERT(rc == 0, "Failed to resume LIS2MDL: %d\n", rc);
    } else {
        rc = pm_device_action_run(magnetometer, PM_DEVICE_ACTION_SUSPEND);
        __ASSERT(rc == 0, "Failed to suspend LIS2MDL: %d\n", rc);
    }
}

double magnetometer_get_heading(void)
{
    return last_heading;
}

static void lis2mdl_trigger_handler(const struct device *dev,
                                    const struct sensor_trigger *trig)
{
    struct sensor_value die_temp2;
    struct sensor_value magn[3];
    sensor_sample_fetch_chan(dev, SENSOR_CHAN_ALL);

    sensor_channel_get(magnetometer, SENSOR_CHAN_MAGN_XYZ, magn);
    sensor_channel_get(magnetometer, SENSOR_CHAN_DIE_TEMP, &die_temp2);

    LOG_DBG("LIS2MDL: Magn (gauss): x: %.3f, y: %.3f, z: %.3f\n",
            sensor_value_to_double(&magn[0]),
            sensor_value_to_double(&magn[1]),
            sensor_value_to_double(&magn[2]));

    LOG_DBG("LIS2MDL: Temperature: %.1f C\n",
            sensor_value_to_double(&die_temp2));

    last_heading = xyz_to_rotation(sensor_value_to_double(&magn[0]),
                                   sensor_value_to_double(&magn[1]),
                                   sensor_value_to_double(&magn[2]));

    LOG_ERR("%f, %f, %f",sensor_value_to_double(&magn[0]),
                                   sensor_value_to_double(&magn[1]),
                                   sensor_value_to_double(&magn[2]));

    LOG_DBG("Rotation: %f", last_heading);
}

// https://arduino.stackexchange.com/questions/18625/converting-three-axis-magnetometer-to-degrees/88707#88707
// Note this assumes watch is flat to eath, TODO use accelerometer to compensate when tilted.
static double xyz_to_rotation(double x, double y, double z)
{
    double heading = (atan2(y,x) - 0.1) * 180 / M_PI;
    if (heading < 0) heading += 360;
    if (heading > 360) heading -= 360;
    return heading;
}
```

## src/zsw_power_manager.c
```c
/*
 * This file is part of ZSWatch project <https://github.com/jakkra/ZSWatch/>.
 * Copyright (c) 2023 Jakob Krantz.
 *
 * This program is free software: you can redistribute it and/or modify
 * it under the terms of the GNU General Public License as published by
 * the Free Software Foundation, version 3.
 *
 * This program is distributed in the hope that it will be useful, but
 * WITHOUT ANY WARRANTY; without even the implied warranty of
 * MERCHANTABILITY or FITNESS FOR A PARTICULAR PURPOSE. See the GNU
 * General Public License for more details.
 *
 * You should have received a copy of the GNU General Public License
 * along with this program. If not, see <http://www.gnu.org/licenses/>.
 */

#include <zsw_power_manager.h>
#include <zephyr/kernel.h>
#include <zephyr/init.h>
#include <events/accel_event.h>
#include <zephyr/zbus/zbus.h>
#include <display_control.h>
#include <lvgl.h>
#include <zephyr/logging/log.h>
#include <events/activity_event.h>
#include <ram_retention_storage.h>
#include <zsw_cpu_freq.h>

LOG_MODULE_REGISTER(zsw_power_manager, LOG_LEVEL_DBG);

#ifdef CONFIG_BOARD_NATIVE_POSIX
#define IDLE_TIMEOUT_SECONDS    UINT32_MAX
#else
#define IDLE_TIMEOUT_SECONDS    30
#endif

static void enter_active(void);
static void enter_inactive(void);
static void handle_idle_timeout(struct k_work *item);
static void zbus_accel_data_callback(const struct zbus_channel *chan);

K_WORK_DELAYABLE_DEFINE(idle_work, handle_idle_timeout);

ZBUS_CHAN_DECLARE(activity_state_data_chan);

ZBUS_CHAN_DECLARE(accel_data_chan);
ZBUS_LISTENER_DEFINE(power_manager_accel_lis, zbus_accel_data_callback);

static bool is_active = true;
static uint32_t last_wakeup_time;

bool zsw_power_manager_reset_idle_timout(void)
{
    if (!is_active) {
        // If we are inactive, then this means we we should enter active.
        enter_active();
        return true;
    } else {
        // We are active, then just reschdule the inactivity timeout.
        k_work_reschedule(&idle_work, K_SECONDS(IDLE_TIMEOUT_SECONDS));
        return false;
    }
}

uint32_t zsw_power_manager_get_ms_to_inactive(void)
{
    if (!is_active) {
        return 0;
    }
    uint32_t time_since_lvgl_activity = lv_disp_get_inactive_time(NULL);
    uint32_t time_to_timeout = k_ticks_to_ms_ceil32(k_work_delayable_remaining_get(&idle_work));

    if (time_since_lvgl_activity >= IDLE_TIMEOUT_SECONDS * 1000) {
        return time_to_timeout;
    } else {
        return MAX(time_to_timeout, IDLE_TIMEOUT_SECONDS * 1000 - lv_disp_get_inactive_time(NULL));
    }
}

static void enter_inactive(void)
{
    LOG_DBG("Enter inactive");
    is_active = false;
    retained.wakeup_time += k_uptime_get_32() - last_wakeup_time;
    retained_update();
    display_control_power_on(false);
    zsw_cpu_set_freq(ZSW_CPU_FREQ_DEFAULT, false);

    struct activity_state_event evt = {
        .state = ZSW_ACTIVITY_STATE_INACTIVE,
    };
    zbus_chan_pub(&activity_state_data_chan, &evt, K_MSEC(250));
}

static void enter_active(void)
{
    LOG_DBG("Enter active");
    is_active = true;
    last_wakeup_time = k_uptime_get_32();

    // Running at max CPU freq consumes more power, but rendering we
    // want to do as fast as possible. Also to use 32MHz SPI, CPU has
    // to be running at 128MHz. Meaning this improves both rendering times
    // and the SPI transmit time.
    zsw_cpu_set_freq(ZSW_CPU_FREQ_FAST, true);
    display_control_power_on(true);

    struct activity_state_event evt = {
        .state = ZSW_ACTIVITY_STATE_ACTIVE,
    };
    zbus_chan_pub(&activity_state_data_chan, &evt, K_MSEC(250));

    k_work_schedule(&idle_work, K_SECONDS(IDLE_TIMEOUT_SECONDS));
}

static void handle_idle_timeout(struct k_work *item)
{
    uint32_t last_lvgl_activity_ms = lv_disp_get_inactive_time(NULL);

    if (last_lvgl_activity_ms > IDLE_TIMEOUT_SECONDS * 1000) {
        enter_inactive();
    } else {
        k_work_schedule(&idle_work, K_MSEC(IDLE_TIMEOUT_SECONDS * 1000 - last_lvgl_activity_ms));
    }
}

static void zbus_accel_data_callback(const struct zbus_channel *chan)
{
    bool should_wakeup = false;
    const struct accel_event *event = zbus_chan_const_msg(chan);

    switch (event->data.type) {
        case ACCELEROMETER_EVT_TYPE_WRIST_WAKEUP: {
            should_wakeup = true;
        }
        default:
            break;
    }

    if (should_wakeup && !is_active) {
        LOG_DBG("Wakeup gesture detected");
        enter_active();
    }
}

static int zsw_power_manager_init(void)
{
    last_wakeup_time = k_uptime_get_32();
    k_work_schedule(&idle_work, K_SECONDS(IDLE_TIMEOUT_SECONDS));
    return 0;
}

SYS_INIT(zsw_power_manager_init, APPLICATION, CONFIG_APPLICATION_INIT_PRIORITY);
```
